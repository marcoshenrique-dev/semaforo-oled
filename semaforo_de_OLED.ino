#define Buzzer 6
#define vermelho 12
#define amarelo 11
#define verde 10

#include <MicroLCD.h>

#include <Wire.h>
#include <Arduino.h>

LCD_SSD1306 lcd;  


#define pinB1 9
#define pinB2 8
#define Valordebounc 180 

bool estadoAnt1=LOW;
bool estadoAnt2=LOW;


unsigned long DebounceB1;
unsigned long DebounceB2;
byte inverso=0;
byte contador=0;
bool Antmudanca=0;
bool mudanca;
const PROGMEM uint8_t PEDESTRE [48*48/8] = {


0xFF, 0xFF, 0xFF, 0xFF, 0xFF, 0xFF, 0xFF, 0xFF, 0xFF, 0xFF, 0xFF, 0xFF, 0xFF, 0xFF, 0x1F, 0x0F,
0x07, 0x07, 0x07, 0x07, 0x07, 0x0F, 0x0F, 0x3F, 0xFF, 0xFF, 0xFF, 0xFF, 0xFF, 0xFF, 0xFF, 0xFF,
0xFF, 0xFF, 0xFF, 0xFF, 0xFF, 0xFF, 0xFF, 0xFF, 0xFF, 0xFF, 0xFF, 0xFF, 0xFF, 0xFF, 0xFF, 0xFF,
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0xFF, 0xFF, 0xFF, 0xFF, 0xFF, 0xFF, 0xFE, 0xF8, 0xF0, 0xF0, 0xF8, 0xF8, 0xFC, 0xFC, 0xFE, 0xFF
};







void setup() {
 lcd.begin();
 pinMode(vermelho,OUTPUT);
 pinMode(amarelo,OUTPUT);
 pinMode(verde,OUTPUT);
 pinMode(Buzzer,OUTPUT);

 pinMode(pinB1,INPUT);
pinMode(pinB2,INPUT);
}

void loop() {
  bool estadoB1=digitalRead(pinB1);
  bool estadoB2=digitalRead(pinB2);
   
  if((millis()-DebounceB1)>Valordebounc){
    if(estadoB1 && estadoAnt1){
      DebounceB1=millis();
      contador=1;
      inverso=0;
    }
  }
  if((millis()-DebounceB2)>Valordebounc){
    if(estadoB2 && estadoAnt2){
      DebounceB2=millis();
      contador=3;
      inverso++;
    }
  }


if(contador==0){
   lcd.setCursor(20,1);
    lcd.setFontSize(FONT_SIZE_MEDIUM);
    lcd.println("Transito ");
    lcd.setCursor(20,5);
    lcd.setFontSize(FONT_SIZE_MEDIUM);
    lcd.println("Livre! ");
    digitalWrite(verde,HIGH);
  
 
}
   if(contador==1 ){
    digitalWrite(verde,LOW);
   
    lcd.setCursor(20,5);
    lcd.setFontSize(FONT_SIZE_MEDIUM);
    lcd.println("ATENCAO!");
    digitalWrite(amarelo,HIGH);
    delay(5000);
   digitalWrite(amarelo,LOW);
    contador=2;
    lcd.clear();
    
    
    Antmudanca=1;
   }
    
if(contador==2){
 mudanca=0;
 digitalWrite(amarelo,LOW);
  digitalWrite(verde,LOW);
 
 
 digitalWrite(vermelho,HIGH);

 lcd.setCursor(40,1);
 lcd.draw(PEDESTRE,48,48);
 
 
 analogWrite(Buzzer,150); 
 
}

if(contador==3 ){
  lcd.clear();
  digitalWrite(vermelho,LOW);
  digitalWrite(verde,LOW);
  digitalWrite(amarelo,LOW);
  digitalWrite(Buzzer,LOW);
  contador=0;
}}

if(estadoB1==1){
  lcd.clear();
  
}
estadoAnt1=estadoB1;
estadoAnt2=estadoB2;
Antmudanca=mudanca;



}
